## simulation/numerical_integration/tests/integration/testcase.yaml
```yaml
tests:
  # section.subsection
  numerical.integration.ztest:
    # build_only: true
    platform_allow:
      - qemu_cortex_m3
    tags: test_framework
```
